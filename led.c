#include <msp430f249.h>
#include "led.h"
#define uchar unsigned char
#define uint unsigned int

uchar const Table_of_Digits[] = 
{
  0x00,0x3C,0x66,0x42,0x42,0x66,0x3C,0x00, //0
  0x00,0x08,0x38,0x08,0x08,0x08,0x3E,0x00, //1
  0x00,0x3C,0x42,0x04,0x08,0x32,0x7E,0x00, //2
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  0x00,0x38,0x46,0x42,0x3E,0x06,0x3C,0x00  //9
};

uchar const Table_of_rows[] = {0x01,0x02,0x04,0x08,0x10,0x20,0x40,0x80};

void delayus(uint t)
{
  while (t--);
}


void LEDshow (void)
{
  uchar num;
  uchar row;
  uchar fps;
  uint digit;
  digit = 0;
  for(num = 0;num < 10;num++)
  {
    for(fps = 0;fps < 200;++fps)
    {
      digit = num * 8;
      for(row = 0;row < 9;++row)
      {
      P2OUT =~ Table_of_rows[row];
      P1OUT =~ Table_of_Digits[digit];
      ++digit;
      delayus(50);
      }
    }
  }
  digit = 0;
}